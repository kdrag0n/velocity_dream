## drivers/block/zram/Kconfig
```kconfig
config ZRAM
	tristate "Compressed RAM block device support"
	depends on BLOCK && SYSFS && ZPOOL && CRYPTO
	select ZSMALLOC
	select CRYPTO_LZO
	default n
	help
	  Creates virtual block devices called /dev/zramX (X = 0, 1, ...).
	  Pages written to these disks are compressed and stored in memory
	  itself. These disks allow very fast I/O and compression provides
	  good amounts of memory savings.

	  It has several use cases, for example: /tmp storage, use as swap
	  disks and maybe many more.

	  See zram.txt for more information.

if ZRAM

config ZRAM_DEFAULT_ALLOCATOR
	string "Default compressed page allocator"
	default "zsmalloc"
	help
	  Select the default zpool allocator used by zram for the
	  compressed pages stored in memory.

endif
```
